sym_layer {
    display-name = "SYM";
    bindings = <
        &none  &kp LBRC  &kp AMPS  &kp ASTRK &kp LPAR  &kp RBRC     &none &none     &none    &none    &none &none
        &none  &kp COLON &kp DLLR  &kp PRCNT &kp CARET &kp PLUS     &none &kp RSHFT &kp RCMD &kp RALT &kp RCTRL &none
        &none  &kp TILDE &kp EXCL  &kp AT    &kp HASH  &kp PIPE     &none &none &none &none  &none &none
                                   &kp RPAR  &kp LPAR  &kp UNDER       &none    &none    &none
    >;
};
