fun_layer {
    display-name = "FUN";
    bindings = <
        &none  &kp F12  &kp F7  &kp F8  &kp F9     &kp PSCRN        &none  &none     &none    &none    &none      &none
        &none  &kp F11  &kp F4  &kp F5  &kp F6     &kp SLCK         &none  &kp RSHFT &kp RCMD &kp RALT &kp RCTRL  &none
        &none  &kp F10  &kp F1  &kp F2  &kp F3     &kp PAUSE_BREAK  &none  &none     &none    &none    &none      &none
                                &kp K_APP &kp SPACE &kp TAB         &none  &none     &none
    >;
};
