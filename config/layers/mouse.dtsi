mouse_layer {
    display-name = "MOUSE";
    bindings = <
        &none  &none     &none    &none    &none      &none        &none &none          &none            &none            &none &none
        &none  &kp LCTRL &kp LALT &kp LCMD &kp LSHFT  &none        &none &mmv MOVE_LEFT &mmv MOVE_DOWN   &mmv MOVE_UP     &mmv MOVE_RIGHT &none
        &none  &none     &none    &none    &none      &none        &none &msc SCRL_LEFT &msc SCRL_UP     &msc SCRL_DOWN   &msc SCRL_RIGHT &none
                                 &none  &none  &none               &mkp MCLK      &mkp LCLK        &mkp RCLK
    >;
};
