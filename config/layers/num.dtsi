num_layer {
    display-name = "NUM";
    bindings = <
        &none  &kp LBKT  &kp N7  &kp N8  &kp N9  &kp RBKT        &none  &none     &none    &none    &none     &none
        &none  &kp SEMI  &kp N4  &kp N5  &kp N6  &kp EQUAL       &none  &kp RSHFT &kp RCMD &kp RALT &kp RCTRL &none
        &none  &kp GRAVE &kp N1  &kp N2  &kp N3  &kp BSLH        &none  &none     &none    &none    &none     &none
                                 &kp DOT &kp N0  &kp MINUS       &none  &none     &none
    >;
};
