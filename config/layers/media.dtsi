media_layer {
    display-name = "MEDIA";
    bindings = <
        &none  &none     &none    &none      &none     &none      &none &none       &kp C_BRI_DN      &kp C_BRI_UP      &none       &none
        &none  &kp LCTRL &kp LALT &kp LCMD   &kp LSHFT &none      &none &kp C_PREV  &kp C_VOL_DN      &kp C_VOL_UP      &kp C_NEXT  &none
        &bt BT_DISC 3 &bt BT_DISC 2 &bt BT_DISC 1 &bt BT_DISC 0   &none &none &bt BT_CLR  &bt BT_SEL 0      &bt BT_SEL 1      &bt BT_SEL 2&bt BT_SEL 3
                                  &none      &none     &none      &none &kp C_PLAY_PAUSE  &kp C_MUTE
    >;
};
