default_layer {
    display-name = "BASE";
// -----------------------------------------------------------------------------------------
// |  Q  |  W  |  F  |  P  |  B  |   |  J  |  L   |  U  |  Y  |  '  |
// |  A  |  R  |  S  |  T  |  G  |   |  M  |  N   |  E  |  I  |  O  |
// |  Z  |  X  |  C  |  D  |  V  |   |  K  |  H   |  ,  |  .  |  /  |
//                    | ESC | SPC | TAB |   | ENT | BSPC  | DEL |
                        bindings = <
   &none  &kp Q  &kp W  &kp F  &kp P  &kp B   &kp J  &kp L  &kp U  &kp Y  &kp SQT  &none
   &none  &hml LCTRL A  &hml LALT R  &hml LCMD S  &hml LSHFT T  &kp G   &kp M  &hmr RSHFT N  &hmr RCMD E  &hmr RALT I  &hmr RCTRL O  &none
   &none  &kp Z &kp X &kp C &kp D &kp V   &kp K &kp H  &kp COMMA &kp DOT &kp FSLH &none
                  &kp ESC &lt NAV SPACE &kp TAB   &kp RET &lt NAV BSPC &kp DEL
                        >;
                };
