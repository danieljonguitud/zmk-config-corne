#include <behaviors.dtsi>
#include <dt-bindings/zmk/keys.h>
#include <dt-bindings/zmk/bt.h>

#define ZMK_POINTING_DEFAULT_MOVE_VAL 1200
#define ZMK_POINTING_DEFAULT_SCRL_VAL 20 
#include <dt-bindings/zmk/pointing.h>

#define DEFAULT 0
#define NAV     1
#define MOUSE   2
#define MEDIA   3
#define NUM     4
#define SYM     5
#define FUN     6

/ { 
        keymap {
                compatible = "zmk,keymap";

                #include "layers/base.dtsi"
                #include "layers/nav.dtsi"
                #include "layers/mouse.dtsi"
                #include "layers/media.dtsi"
                #include "layers/num.dtsi"
                #include "layers/sym.dtsi"
                #include "layers/fun.dtsi"
        };
        #include "behaviors.dtsi"
        #include "combos.dtsi"
};
